/*@!Encoding:1252*/

variables
{
  // Global initial Parameter values for ECU simulation ("internal ECU memory")
  int gVehicleSpeedToLockDoor=15; // vehicle speed for locking the doors in km/h
  int gVehicleType=2; // Sedan  
  // Access modes for reading and writing diagnostic parameters
  const cAccessModeNumerical=0;
  const cAccessModePhysical=1;
  const cAccessModeCoded=2;
}

on diagRequest Door.Variant_Coding_Write
{
  diagResponse this resp; // response corresponding to the service handled by this "on diagRequest" handler (Variant_Coding_Write)
  int newSpeed;
  int newVehicleType;
  
  // read parameter (default=physical) and store it for later use
  newVehicleType=(int)this.GetParameter("Codingstring.VehicleType");   
  // "this" refers to the LockConfiguration_Write request
  newSpeed=(int)this.GetParameter(cAccessModePhysical, "Codingstring.VehicleSpeedToLockDoor"); 
  
  if(newSpeed>250 || newSpeed <0 || gVehicleType<=0 || gVehicleType>3) {
    // Negative Response Code (NRC): Request out of Range (as example)
    // Equivalent syntax: DiagSendNegativeResponse(resp,0x31);
    resp.SendNegativeResponse(0x31); 
  }    
  else
  {
    // Save the speed and car type into internal ECU memory for next read access
    gVehicleSpeedToLockDoor=newSpeed; 
    gVehicleType=newVehicleType;    
    // send positive response, value has been written
    resp.SendPositiveResponse(); 
  }
}

