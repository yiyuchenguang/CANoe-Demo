VERSION ""

NS_ :

BS_:

BU_: ECU2 ECU1
VAL_TABLE_ color 2 "green" 1 "orange" 0 "red" ;

BO_ 2 New_Message_2: 8 ECU2
 SG_ New_Signal_2 : 0|8@1- (1,0) [0|0] ""  ECU1

BO_ 1 New_Message_1: 8 ECU1
 SG_ New_Signal_1 : 0|8@1- (10,0) [0|100] ""  ECU2

EV_ env_EngineStatus: 0 [0|2] "" 2 1 DUMMY_NODE_VECTOR0 Vector__XXX;

EV_ env_Data: 0 [0|0] "" 0 2 DUMMY_NODE_VECTOR0 Vector__XXX;

EV_ env_Text: 0 [0|0] "" 0 3 DUMMY_NODE_VECTOR8000 Vector__XXX;

EV_ env_Speed: 1 [0|0] "Km/h" 0 4 DUMMY_NODE_VECTOR1  ECU2;

EV_ env_Year: 0 [0|8272] "" 0 5 DUMMY_NODE_VECTOR0  ECU1;
ENVVAR_DATA_ env_Data: 2;

CM_ EV_ env_EngineStatus "this variable descriabled the engine status";
BA_DEF_ SG_  "GenSigStartValue" FLOAT 0 100000000000;
BA_DEF_ SG_  "GenSigSendType" ENUM  "Cyclic","OnWrite","OnWriteWithRepetition","OnChange","OnChangeWithRepetition","IfActive","IfActiveWithRepetition";
BA_DEF_ BO_  "GenMsgDelayTime" INT 1 1000;
BA_DEF_ BO_  "GenMsgCycleTime" INT 2 50000;
BA_DEF_ BO_  "GenMsgCycleTimeFast" INT 2 100000;
BA_DEF_ BO_  "GenMsgILSupport" ENUM  "No","Yes";
BA_DEF_ BU_  "ILUsed" ENUM  "Yes","No";
BA_DEF_DEF_  "GenSigStartValue" 0;
BA_DEF_DEF_  "GenSigSendType" "Cyclic";
BA_DEF_DEF_  "GenMsgDelayTime" 1;
BA_DEF_DEF_  "GenMsgCycleTime" 2;
BA_DEF_DEF_  "GenMsgCycleTimeFast" 100;
BA_DEF_DEF_  "GenMsgILSupport" "Yes";
BA_DEF_DEF_  "ILUsed" "Yes";
BA_ "GenMsgCycleTime" BO_ 2 100;
BA_ "GenMsgCycleTime" BO_ 1 100;
BA_ "GenSigStartValue" SG_ 1 New_Signal_1 5;
VAL_ env_EngineStatus 2 "green" 1 "orange" 0 "red" ;
