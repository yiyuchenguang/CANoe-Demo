/*@!Encoding:936*/
includes
{
    #pragma library("capldll.dll") 
}

variables
{
  
}

