/*@!Encoding:936*/
includes
{
  
}

variables
{
  
}

on key 'e'    
{

  
  @env_Year = 2022; 
  write("env_Year is :%d",@env_Year);

  @env_Speed = 60.4; 
  write("env_Year is :%f",@env_Speed);

  
}