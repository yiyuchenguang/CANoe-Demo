AUTOSAR XML (schema 4-2-2)
standard types defined: boolean, sint16
package /VectorAutosarExplorerGeneratedObjects/SYSTEM
  system System
package /VectorAutosarExplorerGeneratedObjects/bmw
  can cluster bmw: baudrate=500000, protocol-name=CAN, speed=250000
    can physical channel CANL: comm-connectors=[Connector_Display_e5363e23caa7b301, Connector_Engine_00afe69e27ffe226, Connector_Light_6ce3a20df31aa097]
      frame EngineState: id 0x123, from Engine, to Display, frame-length=2, can-addressing-mode=STANDARD, can-frame-tx-behavior=CAN-FD
        pdu EngineState_NewPDU: length=2, minimum-delay=0.001, transmission-mode-false-timing=cyclic-timing={time-offset=0, time-period=0.1}, transmission-mode-true-timing=cyclic-timing={time-offset=0, time-period=0.1}
          signal EngineSpeed: start 1, 15 bit, little-endian, system signal EngineSpeed_8988e15b9cedccdc, base-type=sint16, compu {phys=raw for raw 0..1000}, transfer-property=PENDING, to Display
          signal OnOff: start 0, 1 bit, little-endian, system signal EngineState_NewPDU_NewSignal_af0756d76e077599, base-type=boolean, compu-method=OnOff_Encoding, compu {phys=raw for raw 0..1, 0=Cx0_Off, 1=Cx1_On}, transfer-property=PENDING, to Display
      frame LightState: id 0x321, from Light, to Display, frame-length=1, can-addressing-mode=STANDARD, can-frame-tx-behavior=CAN-20
        pdu LightState_NewPDU: length=1, transmission-mode-false-timing=cyclic-timing={time-offset=0.01, time-period=0.1}, transmission-mode-true-timing=cyclic-timing={time-offset=0, time-period=0.1}
          signal FlashLight: start 0, 1 bit, little-endian, system signal FlashLight_cf8144c65d43f37d, base-type=boolean, compu {phys=raw for raw 0..1}, to Display
          signal HeadLight: start 1, 1 bit, little-endian, system signal HeadLight_184972388aba1246, data-type-policy=OVERRIDE, base-type=boolean, compu {phys=raw for raw 0..1}, to Display
package /VectorAutosarExplorerGeneratedObjects/ECU_INSTANCES
  ecu instance Display: associated-com-i-pdu-group=[PduGroup_404f0cbb6d554006b0102d96ece54b60_Rx, PduGroup_ccf920846f5348d787739d4ca725013e_Rx], diagnostic-address=0
    can communication controller Controller_Display_24a91b23b3c5d986
    can communication connector Connector_Display_e5363e23caa7b301: comm-controller=Controller_Display_24a91b23b3c5d986
  ecu instance Engine: associated-com-i-pdu-group=PduGroup_8f71761a3ddd48b0ac65894d6e7a855b_Tx, diagnostic-address=0
    can communication controller Controller_Engine_de7789cee9cb356c
    can communication connector Connector_Engine_00afe69e27ffe226: comm-controller=Controller_Engine_de7789cee9cb356c
  ecu instance Light: associated-com-i-pdu-group=PduGroup_1e1f688e266d45d29e474c0301c28aa5_Tx, diagnostic-address=0
    can communication controller Controller_Light_370dd757c16c591a
    can communication connector Connector_Light_6ce3a20df31aa097: comm-controller=Controller_Light_370dd757c16c591a
package /VectorAutosarExplorerGeneratedObjects/PDU_GROUP
  4 x i signal i pdu group:
    PduGroup_8f71761a3ddd48b0ac65894d6e7a855b_Tx: communication-direction=OUT
    PduGroup_404f0cbb6d554006b0102d96ece54b60_Rx: communication-direction=IN
    PduGroup_1e1f688e266d45d29e474c0301c28aa5_Tx: communication-direction=OUT
    PduGroup_ccf920846f5348d787739d4ca725013e_Rx: communication-direction=IN
