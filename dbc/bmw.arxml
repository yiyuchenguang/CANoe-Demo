AUTOSAR XML (schema 4-1-2)
standard types defined: boolean, sint16
package /VectorAutosarExplorerGeneratedObjects/SYSTEM
  system System
package /VectorAutosarExplorerGeneratedObjects/BMW
  can cluster BMW: baudrate=250000, protocol-name=CAN, speed=250000
    can physical channel CANChannel: comm-connectors=[Connector_Display_9612af67f144021e, Connector_Engine_5335f7047b1429bc, Connector_Light_334471814cc65d1e]
      frame EngineState_Frame: id 0x123, from Engine, to Display, frame-length=2, can-addressing-mode=STANDARD, can-fd-frame-support=false
        pdu EngineState: length=2, minimum-delay=0.01, transmission-mode-false-timing=cyclic-timing={time-offset=0, time-period=0.1}, transmission-mode-true-timing=cyclic-timing={time-offset=0, time-period=0.1}
          signal OnOff: start 0, 1 bit, little-endian, system signal OnOff_4bd55a4f0060c8e7, base-type=boolean, compu {0=Cx0_Off, 1=Cx1_On, phys=raw for raw 0..1}, to Display
          signal EngineSpeed: start 1, 15 bit, little-endian, system signal EngineSpeed_0c8b31472246a90e, base-type=sint16, compu {phys=raw for raw 16384..16383}, transfer-property=PENDING, to Display
      frame LightState_Frame: id 0x321, from Light, to Display, frame-length=1, can-addressing-mode=STANDARD, can-fd-frame-support=false
        pdu LightState: length=1, minimum-delay=0.01, transmission-mode-false-timing=cyclic-timing={time-offset=0, time-period=0.1}, transmission-mode-true-timing=cyclic-timing={time-offset=0, time-period=0.1}
          signal HeadLight: start 0, 1 bit, little-endian, system signal HeadLight_3539a271b0a2cd9a, base-type=boolean, compu {phys=raw for raw 0..1}, to Display
          signal FlashLight: start 2, 1 bit, little-endian, system signal FlashLight_93d373075656f3ec, data-type-policy=OVERRIDE, base-type=boolean, compu {phys=raw for raw 0..1}, to Display
package /VectorAutosarExplorerGeneratedObjects/ECU_INSTANCES
  ecu instance Display: associated-com-i-pdu-group=[PduGroup_e158588527f74ac4acd169edaf95850c_Rx, PduGroup_587b637f2d9f4a368546472ab73c80e2_Rx], diagnostic-address=0
    can communication controller Controller_Display_1b410d56f33a84de
    can communication connector Connector_Display_9612af67f144021e: comm-controller=Controller_Display_1b410d56f33a84de
  ecu instance Engine: associated-com-i-pdu-group=PduGroup_788d0d69fa5c40b29e57e7b6fec57e9e_Tx, diagnostic-address=0
    can communication controller Controller_Engine_a2cd5b1271393735
    can communication connector Connector_Engine_5335f7047b1429bc: comm-controller=Controller_Engine_a2cd5b1271393735
  ecu instance Light: associated-com-i-pdu-group=PduGroup_55cabddd762242148624ddebfa78fee3_Tx, diagnostic-address=0
    can communication controller Controller_Light_c574d35da0a1a1a7
    can communication connector Connector_Light_334471814cc65d1e: comm-controller=Controller_Light_c574d35da0a1a1a7
package /VectorAutosarExplorerGeneratedObjects/PDU_GROUP
  4 x i signal i pdu group:
    PduGroup_788d0d69fa5c40b29e57e7b6fec57e9e_Tx: communication-direction=OUT
    PduGroup_e158588527f74ac4acd169edaf95850c_Rx: communication-direction=IN
    PduGroup_55cabddd762242148624ddebfa78fee3_Tx: communication-direction=OUT
    PduGroup_587b637f2d9f4a368546472ab73c80e2_Rx: communication-direction=IN
package /VectorAutosarExplorerGeneratedObjects/BASE_TYPES
  base type New_BaseType: base-type-encoding=BOOLEAN
  base type New_BaseType_1: base-type-size=16, base-type-encoding=NONE
