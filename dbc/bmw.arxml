AUTOSAR XML (schema 4-0-3)
package /VectorAutosarExplorerGeneratedObjects/SYSTEM
  system System
package /VectorAutosarExplorerGeneratedObjects/BMW
  can cluster BMW: baudrate=250000, protocol-name=CAN, speed=500000
    can physical channel CANL
